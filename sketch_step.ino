/*
  pedometer.ino
  ESP32-S2 Mini starter sketch
*/
// FreeRTOS includes for threading

/*#include "SPI.h"
#include "Adafruit_GFX.h"
#include "Adafruit_GC9A01A.h"
 
#define TFT_DC 21
#define TFT_CS 38
#define TFT_RST 17

Adafruit_GC9A01A tft = Adafruit_GC9A01A(TFT_CS, TFT_DC, TFT_RST);*/

#include <Adafruit_GFX.h>
#include <Adafruit_GC9A01A.h>
#include <SPI.h>
#include <DIYables_TFT_Round.h>

// GC9A01 wiring
#define TFT_BLK  40
#define TFT_CS   38
#define TFT_SCL  36
#define TFT_SDA  34
#define TFT_DC   21
#define TFT_RES  17

Adafruit_GC9A01A tft(TFT_CS, TFT_DC, TFT_RES);

//TFT_eSPI tft = TFT_eSPI();           // TFT object

//TFT_eSprite spr = TFT_eSprite(&tft); // Sprite object


int x = 0;
int y = 175;
int w = 240;
int h = 125;

String pace = "Stopped";

const int buttonPin = 11;

int offset = 0;
int calibratedValue = 0;
 
bool lastButtonState = HIGH;

//Pins for each axis of the accelerometer
const int xSig = 4;
const int ySig = 2;
const int zSig = 1;

//pin for the SelfTest Enable
const int ST = 6;
const int thresholdX = 50;
const int thresholdY = 50;
const int thresholdZ = 50;
//Self Test results
bool selfTestPassed = false;


// Pace Detection Variables
int paces = 0;
bool testing = false;

const int led1 = 13;
const int led2 = 14;
const int led3 = 12;

int currentSteps = 0;
int lastSteps = 0;

unsigned long paceTimer = 0;
// End Pace Detection Var

unsigned long stepCountMill = 0;
unsigned long lowCountMill = 0;
unsigned long possMill = 0;
unsigned long timef = 0;
bool check = false;
int possibleSteps = 0;
bool counting = false;

// Button Input
const int button = 10;
const int debounceDelay = 50; // milliseconds
unsigned long lastButtonPressTime = 0;
// End Button Input

int img_width = 200;
int img_height = 200;

uint16_t SCREEN_WIDTH;
uint16_t SCREEN_HEIGHT;

const uint16_t myBitmap[] = {
0xffff, 0xffff, 0xffff, 0xffff, 0xdefb, 0xe73c, 0xdefb, 0xef5d, 0xffff, 0xffff, 0xffff, 0xe73c,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 0xef7d, 
0xdefb, 0xffff, 0xffff, 0xffff, 0xffdf, 0xdedb, 0xdefb, 0xdefb, 0xef7d, 0xffff, 0xffff, 0xffff,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 0xf79e, 
0xdefb, 0xffdf, 0xffff, 0xffff, 0xffdf, 0xe71c, 0xdefb, 0xdefb, 0xef5d, 0xffff, 0xffff, 0xffff,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 0xf79e, 
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0xdefb,
};


int averageAnalogMilliVolts(int pin) {
  long total = 0;
  const int sampleCount = 5;

  for (int i = 0; i < sampleCount; i++) {
    total += analogReadMilliVolts(pin);
    delay(10);
  }

  return total / sampleCount;
}

bool buttonPressed() {
  unsigned long currentTime = millis();
  if (digitalRead(button) == LOW && (currentTime - lastButtonPressTime) > debounceDelay) {
    lastButtonPressTime = currentTime;
    return true;
  }
  return false;
}

void paceDetect() {
  if(millis() - paceTimer > 1000) {
    paceTimer = millis();
  switch (paces) {
    case 0:
      digitalWrite(led1, LOW);
      digitalWrite(led2, LOW);
      digitalWrite(led3, LOW);
      pace = "Stopped";
      tft.fillRect(x, y, w, h, GC9A01A_BLACK);

        tft.setTextColor(GC9A01A_RED);
        tft.setTextSize(4);
        tft.setCursor(95, 180);
        tft.print(currentSteps);
        tft.setTextSize(2);
        tft.setCursor(70, 210);
        tft.print(pace);
        drawCircularProgress(currentSteps);
      //Serial.println("beans0");

      if(currentSteps - lastSteps >= 1) {
        paces = 1;
      }
      
      break;
    case 1:
      digitalWrite(led1, HIGH);
      digitalWrite(led2, LOW);
      digitalWrite(led3, LOW);
      pace = "Walking";
      tft.fillRect(x, y, w, h, GC9A01A_BLACK);

        tft.setTextColor(GC9A01A_RED);
        tft.setTextSize(4);
        tft.setCursor(95, 180);
        tft.print(currentSteps);
        tft.setTextSize(2);
        tft.setCursor(70, 210);
        tft.print(pace);
        drawCircularProgress(currentSteps);

        if(currentSteps - lastSteps >= 3) {
          paces = 2;
        } else if (currentSteps - lastSteps < 1) {
          paces = 0;
        }
      break;
    case 2: 
      digitalWrite(led1, HIGH);
      digitalWrite(led2, HIGH);
      digitalWrite(led3, LOW);
      pace = "Jogging";
      tft.fillRect(x, y, w, h, GC9A01A_BLACK);

        tft.setTextColor(GC9A01A_RED);
        tft.setTextSize(4);
        tft.setCursor(95, 180);
        tft.print(currentSteps);
        tft.setTextSize(2);
        tft.setCursor(70, 210);
        tft.print(pace);
        drawCircularProgress(currentSteps);
        if(currentSteps - lastSteps >= 4) {
          paces = 3;
        } else if (currentSteps - lastSteps < 3) {
          paces = 1;
        }
      break;
    case 3:
      digitalWrite(led1, HIGH);
      digitalWrite(led2, HIGH);
      digitalWrite(led3, HIGH);
      pace = "KACHOW";
      tft.fillRect(x, y, w, h, GC9A01A_BLACK);

        tft.setTextSize(5);
        tft.setCursor(30, 180);
        tft.print(pace);
        drawCircularProgress(currentSteps);
      if(currentSteps - lastSteps < 4) {
        paces = 2;
      }
      break;
  }
  lastSteps = currentSteps;
  if(testing) {
    currentSteps += random(0, 7);
  }
}
}

bool selftest() {
  int selfTestAttempts = 0;
  while (selfTestAttempts < 3 && !selfTestPassed) {
    // Log attempt
    Serial.print("Self-test attempt ");
    Serial.println(selfTestAttempts + 1);

    // Enable self test mode
    digitalWrite(ST, LOW);
    delay(100); // Wait for the self test to stabilize

    // Read the accelerometer values in self test mode
    int xSelfTest = averageAnalogMilliVolts(xSig);
    int ySelfTest = averageAnalogMilliVolts(ySig);
    int zSelfTest = averageAnalogMilliVolts(zSig);

    Serial.print("SelfTest readings mV: X="); Serial.print(xSelfTest);
    Serial.print(" Y="); Serial.print(ySelfTest);
    Serial.print(" Z="); Serial.println(zSelfTest);

    // Disable self test mode
    digitalWrite(ST, HIGH);
    delay(100);

    // Read the accelerometer values in normal mode
    int xNormal = averageAnalogMilliVolts(xSig);
    int yNormal = averageAnalogMilliVolts(ySig);
    int zNormal = averageAnalogMilliVolts(zSig);

    Serial.print("Normal readings mV: X="); Serial.print(xNormal);
    Serial.print(" Y="); Serial.print(yNormal);
    Serial.print(" Z="); Serial.println(zNormal);

    // Calculate the signed deltas in millivolts
    int xDiff = xSelfTest - xNormal;
    int yDiff = ySelfTest - yNormal;
    int zDiff = zSelfTest - zNormal;

    Serial.print("Diff mV: X="); Serial.print(xDiff);
    Serial.print(" Y="); Serial.print(yDiff);
    Serial.print(" Z="); Serial.println(zDiff);

    // Check if the deltas are within the expected ranges
    if (xDiff > -900 && xDiff < -330 &&
        yDiff > 100 && yDiff < 530 &&
        zDiff > 100 && zDiff < 830) {
      selfTestPassed = true;
      Serial.println("Self-test: PASS");
      return true; // Self test passed
    }

    Serial.println("Self-test attempt result: FAIL");

    ++selfTestAttempts; // Increment the self test attempts counter
  }

  return false; // Self test failed
}

void stepCount() {
  /*Serial.print(analogRead(xSig));
  Serial.print(" ");
  Serial.print(analogRead(ySig));
  Serial.print(" ");
  Serial.println(analogRead(zSig));
  */
  
  int data = sqrt((analogRead(xSig)^2) + (analogRead(ySig)^2) + (analogRead(zSig)^2));
  //int data = (abs(analogRead(xSig)) + abs(analogRead(ySig)) + abs(analogRead(zSig)));
  
  //Serial.print("data: "); Serial.println(data);
  data = calibration(data);
  //delay(10);
  timef = millis();
  if(data > 0) {
    stepCountMill = millis();
    check = true;
    //Serial.println("high");
  }
  if(check == true) {
    //Serial.println(data);
    if(data < -1) {
      if(counting){
        lowCountMill = millis();
        currentSteps ++;
        Serial.print("steps: "); Serial.println(currentSteps);
        
        //tft.fillScreen(GC9A01A_BLACK);
        
        if(paces != 3) {
        tft.fillRect(x, y, w, h, GC9A01A_BLACK);

        tft.setTextColor(GC9A01A_RED);
        tft.setTextSize(4);
        tft.setCursor(95, 180);
        tft.print(currentSteps);
        tft.setTextSize(2);
        tft.setCursor(70, 210);
        tft.print(pace); 

        drawCircularProgress(currentSteps);
        }
      }
      else{
        possMill = millis();
        possibleSteps ++;
        Serial.print("possible steps: "); Serial.println(possibleSteps);
      }
      check = false;
    }
  }
  if(timef - stepCountMill > 300) {
    check = false;
  }
  if(timef - lowCountMill > 2000 && counting == true) {
    counting = false;
    possibleSteps = 0;
    Serial.println("beans");
  }
  if(possibleSteps > 7 && counting == false) {
    lowCountMill = millis();
    counting = true;
    currentSteps += possibleSteps;
    lastSteps += possibleSteps - 1;
    paces = 1;
  }
  if(timef - possMill > 2000 && counting == false){
    possibleSteps =0;
    //Serial.println("beansforfun");
  }
  //delay(100);

}

// ----------------------------------------------------
// CIRCULAR PROGRESS BAR
// ----------------------------------------------------
void drawCircularProgress(int steps) {
  int progress = constrain(steps, 0, 100);
  float percent = (float)progress / 100;
 
  int cx = 120;
  int cy = 120;
 
  int radius = 117;
  int thickness = 10;
 
  int endAngle = percent * 360;
 
  // Colour fades from yellow to red
  int red = 255;
  int green = 255 * (1.0 - percent);
  int blue = 0;
 
  uint16_t progressColor = tft.color565(red, green, blue);
  uint16_t backgroundRingColor = tft.color565(35, 35, 35);
 
  // Draw full dark ring behind progress
  for (int a = 0; a < 360; a++) {
    drawThickArcPixel(cx, cy, radius, thickness, a - 90, backgroundRingColor);
  }
 
  // Draw progress ring clockwise from top
  for (int a = 0; a < endAngle; a++) {
    drawThickArcPixel(cx, cy, radius, thickness, a - 90, progressColor);
  }
}
 
// ----------------------------------------------------
// DRAW THICK ARC PIXELS
// ----------------------------------------------------
void drawThickArcPixel(
  int cx,
  int cy,
  int radius,
  int thickness,
  int angleDeg,
  uint16_t color
) {
  float angleRad = angleDeg * DEG_TO_RAD;
 
  for (int r = radius - thickness + 1; r <= radius; r++) {
    int rx = cx + cos(angleRad) * r;
    int ry = cy + sin(angleRad) * r;
 
    if (rx >= 0 && rx < 240 && ry >= 0 && ry < 240) {
      tft.drawPixel(rx, ry, color);
    }
  }
}

int calibration(int mappedValue) {
  
  // Read button
  bool buttonState = digitalRead(buttonPin);
 
  // Calibration on press
  if (lastButtonState == HIGH && buttonState == LOW) {
    offset = mappedValue;
    currentSteps = 0;

    tft.fillRect(x, y, w, h, GC9A01A_BLACK);

    tft.setTextColor(GC9A01A_RED);
    tft.setTextSize(4);
    tft.setCursor(95, 170);
    tft.print(currentSteps);

    drawCircularProgress(currentSteps);
  }
 
  lastButtonState = buttonState;
 
  // Apply calibration
  calibratedValue = mappedValue - offset;
  Serial.print("calibrated: "); Serial.println(calibratedValue);
  return calibratedValue;
}


void setup() {
  // Initialize Serial for debug output
  Serial.begin(115200);
  delay(100);
  pinMode(buttonPin, INPUT_PULLUP);
  Serial.println("Starting pedometer self-test...");

  // PinMode for ADXL inputs and Self Test output
  // Analog signal inputs
  pinMode(xSig, INPUT);
  pinMode(ySig, INPUT);
  pinMode(zSig, INPUT);
  //output pin for Self Test
  pinMode(ST, OUTPUT);

  // Outputs for Pace Detection
  pinMode(led1, OUTPUT);
  pinMode(led2, OUTPUT);
  pinMode(led3, OUTPUT);
  // Button Input
  pinMode(button, INPUT_PULLUP); 


  // Run the self-test once at startup and report result
  bool passed = selftest();
  if (passed) {
    Serial.println("Self-test PASSED");
  } else {
    Serial.println("Self-test FAILED");
  }
  digitalWrite(ST, HIGH);

  Serial.println("GC9A01A Test!");
 

  pinMode(TFT_BLK, OUTPUT);
  digitalWrite(TFT_BLK, HIGH);   // backlight ON

  SPI.begin(TFT_SCL, -1, TFT_SDA, TFT_CS);

  tft.begin();

  /*tft.fillScreen(GC9A01A_BLACK);
        
  tft.setTextColor(GC9A01A_RED);    tft.setTextSize(5);
  tft.setCursor(25, 60);
  tft.print("Definitely:"); 
  tft.setTextSize(5);
  tft.setCursor(100, 120);
  tft.print(currentSteps);*/

  SCREEN_WIDTH = tft.width();
  SCREEN_HEIGHT = tft.height();

  tft.setRotation(-1);

  int x = (SCREEN_WIDTH - img_width) / 2;
  int y = (SCREEN_HEIGHT - img_height) / 2;

  tft.fillScreen(GC9A01A_WHITE);
  tft.drawRGBBitmap(x, y, myBitmap, img_width, img_height);

  drawCircularProgress(currentSteps);

  

  //Serial.print(F("Circles (filled)         "));
  //Serial.println(testFilledCircles(10, GC9A01A_MAGENTA));
  

  /*Serial.println(F("Benchmark                Time (microseconds)"));
  delay(10);
  Serial.print(F("Screen fill              "));
  Serial.println(testFillScreen());
  delay(500);*/

}

 


void loop() {

  //paceDetect();
  
  stepCount();
  paceDetect();

}